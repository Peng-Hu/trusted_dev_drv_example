OUTPUT_ARCH( "riscv" )

SECTIONS 
{
  . = 0xfffffffff0000000;
  .text : {
    *(.text._start)
    *(.text)
  }
  . = ALIGN(0x1000);
  .rodata : 
  { 
    *(.rdata)
    *(.rodata)
  }
  .data : { *(.data) }
  .bss : { *(.bss) }
  .debug : { *(.debug) }
  _end = .;
}
